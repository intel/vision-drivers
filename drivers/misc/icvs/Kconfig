## drivers/misc/icvs/Kconfig
```kconfig
# SPDX-License-Identifier: GPL-2.0-only
# Copyright (c) 2024 Intel Corporation.

config INTEL_CVS
	tristate "Intel CVS"
	depends on CONFIG_ACPI
	depends on CONFIG_GPIOLIB
	depends on CONFIG_I2C
	help
	  Add support of Intel Computer Vision System (ICVS).
```
